## arch/arm/mach-s5l87xx/Kconfig
```kconfig
if ARCH_S5L87XX

choice
    prompt "S5L87XX board select"
    optional

config TARGET_NANO5G
    bool "Apple iPod Nano 5G"

config TARGET_NANO4G
	bool "Apple iPod Nano 4G"

endchoice

config SYS_SOC
    default "s5l87xx"

source "board/apple/nano5g/Kconfig"
source "board/apple/nano4g/Kconfig"

endif
```

## board/apple/nano4g/Kconfig
```kconfig
if TARGET_NANO4G

config SYS_BOARD
    default "nano4g"

config SYS_VENDOR
    default "apple"

config SYS_CONFIG_NAME
    default "applenano4g"

endif
```
